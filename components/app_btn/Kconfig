## components/app_btn/Kconfig
```kconfig
menu "app_btn -- the panel buttons"

config APP_BTN_ENABLE
    bool "Read the panel's buttons"
    default y
    help
        Three of the Inky Impression's four tactile buttons (PLAN 3b). Harmless with
        nothing wired: an unconnected pin sits high on its pull-up, which is what an
        unpressed button reads as.

config APP_BTN_A_GPIO
    int "Button A"
    default 7
    help
        XIAO D5, Pi header 29.

config APP_BTN_B_GPIO
    int "Button B"
    default 21
    help
        XIAO D6, Pi header 31. Ordinary GPIO on this board only because the console is on
        USB Serial/JTAG rather than UART0 -- see sdkconfig.defaults.esp32c3.

config APP_BTN_C_GPIO
    int "Button C"
    default 20
    help
        XIAO D7, Pi header 36. As with D6, free only because UART0 is not the console.

config APP_BTN_DEBOUNCE_MS
    int "Debounce (ms)"
    default 40
    help
        A press must read low for this long before it counts. Polled rather than
        interrupt-driven: a button pressed by a finger is a slow event, the panel task is
        the only thing with deadlines, and a poll cannot storm the scheduler the way a
        bouncing edge on an ISR can.

config APP_BTN_LONG_PRESS_MS
    int "Long press (ms)"
    default 1500
    help
        Held at least this long reports as a long press. Used for the actions that should
        not happen by brushing against the panel.

endmenu
```

## components/app_cfg/Kconfig
```kconfig
menu "app_cfg -- device configuration"

config APP_CFG_NAMESPACE
    string "NVS namespace for application configuration"
    default "appcfg"
    help
        Every persistent setting the template owns lives in this one namespace, so a
        factory reset has a single, auditable definition.

config APP_CFG_AP_PASS_SALT
    string "SoftAP passphrase salt"
    default "6cm63gj2OhKZWPbKZE1nSL7N"
    help
        Mixed with the device MAC to derive the provisioning AP passphrase. Change it
        for your own fleet: with the default, anyone who knows this project can compute
        the passphrase of any device from its MAC, which the SSID advertises.

config APP_CFG_AP_PASS_FIXED
    string "Fixed SoftAP passphrase (empty = derive per device)"
    default ""
    help
        Leave empty in anything you ship. A fixed passphrase is convenient on a bench
        where you provision the same board repeatedly and would rather not read the
        boot log every time.

endmenu
```

## components/app_display/Kconfig
```kconfig
menu "app_display -- when to redraw"

config APP_DISPLAY_BRINGUP_BAR
    bool "Draw the seven-colour bar at boot"
    default n
    help
        The phase 2 bring-up frame: seven vertical bands straight through the driver,
        held for half a minute so the band order can be checked against the palette
        app_gfx defines.

        Off by default. It is the right first thing to put on a newly wired panel and the
        wrong thing to put on a working one -- 26 seconds of refresh on every boot, for a
        picture that is then immediately replaced, which is the panel wear PLAN 3e exists
        to avoid.

config APP_DISPLAY_TICK_MINUTES
    int "Minutes between redraws"
    default 60
    help
        How often the panel re-renders and, when the weather client is built in, fetches.

        It lives here rather than with app_wx because it is the display's clock: a device
        with no weather client still ticks, to move a forecast from fresh to stale and to
        notice that it no longer starts at the current hour.

        Sixty is chosen by what is on the other end. Open-Meteo's free tier is fair use,
        under 10 000 requests a day against hourly's 24, and the forecast itself only
        changes a few times an hour upstream -- so fetching faster buys nothing and
        spends somebody else's bandwidth. Ticks are aligned to the wall clock, so a
        refresh lands on the hour rather than drifting by however long the last one took.

config APP_DISPLAY_CLEAN_DAYS
    int "Days between panel clean cycles"
    default 7
    range 0 90
    help
        A clean cycle flushes the panel through its colour codes and takes about half a
        minute per pass. E Ink recommend it periodically on an ACeP panel to keep the
        pigments healthy; PLAN 3e schedules it weekly.

        Zero disables it. The clock is wall time and the last run is kept in NVS, so a
        device that reboots daily still cleans weekly rather than never -- the obvious
        implementation, an uptime counter, gives a panel that is never cleaned on any
        device that restarts more often than the interval.

endmenu
```

## components/app_epd/Kconfig
```kconfig
menu "app_epd -- the ePaper panel"

config APP_EPD_ENABLE
    bool "Drive a UC8159 ePaper panel"
    default y
    help
        The Pimoroni Inky Impression 5.7", 600x448, seven colours, UC8159 controller.
        Switch it off to build the firmware without a panel attached.

comment "Pins -- defaults are the Seeed XIAO ESP32-C3 (PLAN 3b)"

config APP_EPD_SCLK_GPIO
    int "SCLK"
    default 8
    help
        XIAO D8. Also an ESP32-C3 strapping pin, which must be high at reset. SCLK is an
        output here and the panel's SCLK is high impedance, so the line should float --
        but if boot becomes intermittent, a 10k pull-up to 3v3 on this pin is the first
        thing to try.

config APP_EPD_MOSI_GPIO
    int "MOSI"
    default 10

config APP_EPD_CS_GPIO
    int "Chip select"
    default 3

config APP_EPD_DC_GPIO
    int "Data/command"
    default 4

config APP_EPD_RST_GPIO
    int "Reset"
    default 5

config APP_EPD_BUSY_GPIO
    int "Busy"
    default 6
    help
        Driven by the panel, low while it is working.

        Must NOT be GPIO9 or GPIO2 on an ESP32-C3: both are strapping pins, and GPIO9 low
        at reset puts the chip into download mode. The panel holds BUSY low exactly while
        the board is coming up, so that combination gives a board which boots only
        sometimes with nothing on the console to explain it.

if APP_EPD_ENABLE

config APP_EPD_SPI_HZ
    int "SPI clock (Hz)"
    default 3000000
    help
        Pimoroni's driver uses 3 MHz on this panel and Soldered's uses 10 MHz on the same
        controller. Both refreshed correctly on the bench board over a dozen jumper wires:
        the 134 400-byte transfer takes 375 ms at 3 MHz and 118 ms at 10 MHz.

        3 MHz is the default because a deployed board at 10 MHz intermittently showed a
        garbled lower part of the picture, cleared by a power cycle. That is the
        signature of a clock edge gained or lost partway through the upload, but the
        cause is inferred, not measured. The quarter-second saved at 10 MHz is nothing
        against a 26-second refresh.

        Going lower buys little: ringing comes from edge speed, which the clock does not
        change, and a slower upload holds CS low for longer. SCLK and MOSI are set to the
        weakest drive strength in app_epd_init() for that reason.

endif

endmenu
```

## components/app_httpd/Kconfig
```kconfig
menu "app_httpd -- device web UI"

config APP_HTTPD_ENABLE
    bool "Serve the device status page and provisioning portal"
    default y
    help
        This is an unauthenticated control surface: anyone on the LAN can reboot the
        board or make it check for an update. Acceptable on a lab network, not on a
        shared one. Turn it off, or put a shared secret in front of it, before anything
        ships (PLAN §7).

config APP_HTTPD_PORT
    int "HTTP port"
    default 80
    depends on APP_HTTPD_ENABLE

config APP_HTTPD_MAX_SOCKETS
    int "Maximum simultaneous connections"
    default 4
    range 1 12
    depends on APP_HTTPD_ENABLE
    help
        Kept low on purpose. Per-connection server buffers sit alongside mbedTLS's
        during an OTA download, and on a low-RAM part that is precisely when both are
        largest (PLAN §7). Test the update path with the page open in a browser.

config APP_HTTPD_STACK
    int "HTTP server task stack size"
    default 5120
    depends on APP_HTTPD_ENABLE

config APP_HTTPD_CAPTIVE_PORTAL
    bool "Answer captive-portal probes and hijack DNS while the AP is up"
    default y
    depends on APP_HTTPD_ENABLE
    help
        Right, and the login sheet pops by itself when a phone joins the provisioning
        AP. Wrong, and the user has to somehow know to browse to 192.168.4.1. The DNS
        responder binds only to the AP interface and only while the AP is up, so it
        never answers for clients on your real network.

config APP_HTTPD_SCAN_MAX
    int "Maximum networks listed by the portal"
    default 20
    range 4 40
    depends on APP_HTTPD_ENABLE

config APP_HTTPD_COREDUMP_DOWNLOAD
    bool "Allow downloading the raw crash dump over HTTP"
    default n
    depends on APP_HTTPD_ENABLE
    help
        The status page always *reports* a stored crash dump -- which task, which program
        counter, the panic reason. That is diagnosis, and it gives nothing away.

        This option additionally serves the raw dump at GET /api/coredump.bin so it can be
        fed to esp-coredump on a workstation. A core dump is a copy of task stacks, so a
        crash that happened during Wi-Fi work can contain the network passphrase, and this
        server has no authentication at all (PLAN §4a). Default off, and it should stay off
        anywhere the LAN is not yours.

        With it off, a dump is still recoverable over a serial cable:
            esptool read-flash <coredump offset> <size> dump.bin

endmenu
```

## components/app_mqtt/Kconfig
```kconfig
menu "app_mqtt -- broker link (optional)"

config APP_MQTT_ENABLE
    bool "Enable the MQTT client"
    default n
    help
        Off by default, and it should be: it needs a broker that may not exist, and
        nothing else in the template depends on it. PLAN §8 lists it as an extra.

        What it is actually for is pushing "check for an update now" to a whole fleet at
        once, instead of waiting out each device's jittered six-hour poll.

config APP_MQTT_BROKER_URI
    string "Broker URI"
    default "mqtts://nas.lan:8883"
    depends on APP_MQTT_ENABLE
    help
        mqtts:// for TLS, which is what the broker in nas/docker-compose.yml serves and
        what you should use. The host must then appear in the server certificate's SAN
        list, exactly as with the OTA base URL.

        mqtt:// also works, for an existing broker on a LAN you trust. Be clear about what
        it costs: the username and password below cross the network in the clear on every
        connect, and so does every command and every status message. The password is
        already weak protection -- it is compiled into the image and shared by the whole
        fleet -- and without TLS it is barely protection at all, so anyone on that network
        can publish commands to your devices. The firmware logs a warning at boot when the
        link is unencrypted rather than letting it pass unremarked.

        The shipped broker has no 1883 listener, because a plaintext port on a broker you
        control gets used "just for testing" and then stays.

config APP_MQTT_USERNAME
    string "Broker username"
    default "esp-ota"
    depends on APP_MQTT_ENABLE

config APP_MQTT_PASSWORD
    string "Broker password"
    default ""
    depends on APP_MQTT_ENABLE
    help
        From tools/gen_mqtt_user.sh. This is build-time configuration shared by every
        device on the broker, not a per-device secret -- anyone who can read an image can
        read it. Acceptable because what the broker controls is "check now", and the
        update itself is signed and verified independently (PLAN §5). If MQTT ever
        carries something that matters more, move to per-device client certificates.

        Empty means the client connects with no credentials, which the shipped
        mosquitto.conf refuses.

config APP_MQTT_TOPIC_PREFIX
    string "Topic prefix"
    default "esp-ota"
    depends on APP_MQTT_ENABLE
    help
        Topics are <prefix>/<device-id>/{status,online,cmd} plus <prefix>/all/cmd for the
        whole fleet. Set it to the project name so one broker can carry several projects,
        the same way one NAS carries several projects' firmware.

config APP_MQTT_STATUS_INTERVAL_S
    int "Seconds between status publishes"
    default 60
    range 5 3600
    depends on APP_MQTT_ENABLE
    help
        Status is also published immediately on connect and whenever something
        interesting changes, so this is the heartbeat rather than the only signal.

config APP_MQTT_KEEPALIVE_S
    int "MQTT keepalive, seconds"
    default 60
    range 10 600
    depends on APP_MQTT_ENABLE
    help
        How long the broker waits before declaring the device gone and publishing its
        last will. Too high and a dashboard shows a dead device as online for minutes;
        too low and a device on poor Wi-Fi flaps.

config APP_MQTT_ALLOW_RESTART
    bool "Accept restart commands from the broker"
    default y
    depends on APP_MQTT_ENABLE
    help
        Anyone who can publish to the command topic can reboot every device at once.
        That is the same trade the web UI already makes (PLAN §7) and the broker at least
        requires a password -- but a fleet-wide reboot is a bigger blast radius than one
        board, so it is worth being able to compile out while leaving "check now" alone.

endmenu
```

## components/app_net/Kconfig
```kconfig
menu "app_net -- connectivity and commissioning"

config APP_NET_FALLBACK_DELAY_S
    int "Seconds without association before raising the provisioning AP"
    default 120
    range 10 3600
    help
        Applies only when credentials are stored. An unprovisioned device raises the AP
        immediately -- there is nothing to wait for.

config APP_NET_AP_LINGER_S
    int "Seconds to keep the AP up after the station associates"
    default 20
    range 0 300
    help
        The grace period in which the portal can tell whoever just typed a passphrase
        that it worked. Tearing the AP down the instant credentials are saved turns a
        mistyped passphrase into a board that silently never appears.

config APP_NET_BACKOFF_MAX_S
    int "Maximum STA reconnect backoff, seconds"
    default 60
    range 5 600

config APP_NET_AP_MAX_STA
    int "Maximum stations on the provisioning AP"
    default 4
    range 1 8

config APP_NET_AP_CHANNEL
    int "Provisioning AP channel"
    default 1
    range 1 13
    help
        Ignored once the station associates: in APSTA the AP follows the station's
        channel, because the radio has only one.

config APP_NET_SNTP_SERVER
    string "SNTP server"
    default "pool.ntp.org"
    help
        SNTP must succeed before the first TLS handshake or certificate validity checks
        fail on a device that boots at 1970 (PLAN §7). DHCP-supplied servers are tried
        as well, which is what makes this work on a LAN with no route to the internet.

config APP_NET_SNTP_FROM_DHCP
    bool "Also accept SNTP servers offered by DHCP"
    default y

config APP_NET_MDNS_ENABLE
    bool "Advertise the device over mDNS"
    default y
    help
        Makes the status page reachable at http://<device-name>.local without anyone
        having to find the DHCP lease.

config APP_NET_TASK_STACK
    int "app_net task stack size"
    default 4096

endmenu
```
